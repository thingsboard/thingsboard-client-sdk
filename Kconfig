## Kconfig
```kconfig
menu "ThingsBoard Client SDK Configurations"

    config THINGSBOARD_ENABLE_DYNAMIC
        bool "Replace static with dynami library usage"
        default n
        help
            If this is enabled the library will use DynamicJsonDocument to receive messages from the MQTT broker and use Vector to hold Subscription data instead of Arrays. Removing the need to declare MaxResponse, MaxSubscriptions, MaxAttributes, MaxRPC and MaxRequestRPC template arguments. But instead increasing heap allocation and usage drastically.

    config THINGSBOARD_ENABLE_DEBUG
        bool "Enable additional debug log messages"
        default n
        help
            If this is enabled the library uses more global constant variables, but will print more about the currently ongoing internal processes. Which might help debug certain issues.

endmenu
```
